## esp32s3-dualusb-fw/sdkconfig.defaults
```kconfig
# ESP32-S3 Dual USB Firmware - Default SDK Configuration (vPT-A4.2)

# Target Configuration
CONFIG_IDF_TARGET="esp32s3"
CONFIG_IDF_TARGET_ESP32S3=y

# Flash Configuration
CONFIG_ESPTOOLPY_FLASHSIZE_8MB=y
CONFIG_ESPTOOLPY_FLASHMODE_DIO=y
CONFIG_ESPTOOLPY_FLASHFREQ_80M=y

# Partition Table Configuration
CONFIG_PARTITION_TABLE_CUSTOM=y
CONFIG_PARTITION_TABLE_CUSTOM_FILENAME="partitions_8mb_factory_storage.csv"
CONFIG_PARTITION_TABLE_OFFSET=0x8000

# Project Version
CONFIG_PROJECT_VERSION="vPT-A4.2"

# FreeRTOS
CONFIG_FREERTOS_HZ=1000

# FATFS
CONFIG_FATFS_LFN_STACK=y
CONFIG_FATFS_CODEPAGE_437=y
CONFIG_FATFS_FS_LOCK=4
CONFIG_FATFS_IMMEDIATE_FSYNC=y
CONFIG_FATFS_USE_FASTSEEK=y

# Wear Levelling
CONFIG_WL_SECTOR_SIZE=4096

# TinyUSB
CONFIG_TINYUSB_MSC_ENABLED=y
CONFIG_TINYUSB_DEBUG_LEVEL=0
CONFIG_TINYUSB_DEVICE_ENABLED=y

# TinyUSB Task Configuration
CONFIG_TINYUSB_TASK_STACK_SIZE=4096
CONFIG_TINYUSB_TASK_PRIORITY=5

# TinyUSB Descriptors
CONFIG_TINYUSB_DESC_MANUFACTURER_STRING="MYCO"
CONFIG_TINYUSB_DESC_PRODUCT_STRING="DualUSB MSC"
CONFIG_TINYUSB_DESC_SERIAL_STRING="1.0"

# Logging
CONFIG_LOG_DEFAULT_LEVEL=3

# Bootloader Optimization
CONFIG_BOOTLOADER_COMPILER_OPTIMIZATION_SIZE=y
CONFIG_BOOTLOADER_LOG_LEVEL_NONE=y

# Coredump
CONFIG_ESP_COREDUMP_ENABLE_TO_NONE=y
```

## esp32s3-dualusb-fw/test/sdkconfig.defaults
```kconfig
# Default SDK Configuration for Unit Tests
# This configuration is optimized for running unit tests on ESP32-S3

# Target Configuration
CONFIG_IDF_TARGET="esp32s3"
CONFIG_IDF_TARGET_ESP32S3=y

# Memory Configuration
CONFIG_ESP32S3_SPIRAM_SUPPORT=y
CONFIG_SPIRAM_USE_MALLOC=y
CONFIG_SPIRAM_MALLOC_ALWAYSINTERNAL=0
CONFIG_SPIRAM_MALLOC_RESERVE_INTERNAL=16384

# Heap Configuration
CONFIG_HEAP_TRACING=y
CONFIG_HEAP_TRACING_STACK_DEPTH=4

# Logging Configuration
CONFIG_LOG_DEFAULT_LEVEL=4
CONFIG_LOG_DEFAULT_LEVEL_INFO=y

# FreeRTOS Configuration
CONFIG_FREERTOS_ENABLE_STATIC_TASK_CLEAN_UP=y
CONFIG_FREERTOS_ENABLE_TASK_SNAPSHOT=y

# Partition Table
CONFIG_PARTITION_TABLE_CUSTOM=y
CONFIG_PARTITION_TABLE_CUSTOM_FILENAME="partitions.csv"

# FATFS Configuration
CONFIG_FATFS_CODEPAGE_DYNAMIC=y
CONFIG_FATFS_CODEPAGE_437=y
CONFIG_FATFS_LFN_UNICODE=y
CONFIG_FATFS_API_ENCODING_UTF_8=y

# Wear Levelling Configuration
CONFIG_WL_SECTOR_SIZE=4096

# USB Configuration
CONFIG_TINYUSB_ENABLED=y
CONFIG_TINYUSB_PORT_FULL_SPEED_0=y
CONFIG_TINYUSB_DEVICE_ENABLED=y
CONFIG_TINYUSB_DEVICE_MSC_ENABLED=y

# Unity Testing Framework
CONFIG_UNITY_ENABLE_FIXTURE=y
CONFIG_UNITY_ENABLE_DOUBLE=y

# Performance Monitoring
CONFIG_PERF_MONITOR_ENABLED=y

# Debug Configuration
CONFIG_ESP_ERR_TO_NAME_LOOKUP=y
CONFIG_ESP_SYSTEM_CHECK_FREQ_HZ=1000

# Optimization
CONFIG_COMPILER_OPTIMIZATION_SIZE=y
CONFIG_COMPILER_OPTIMIZATION_ASSERTIONS_ENABLE=y

# Security
CONFIG_SECURE_BOOT_ENABLED=n
CONFIG_SECURE_FLASH_ENC_ENABLED=n
```

## sdkconfig.defaults
```kconfig
# ESP32-S3 Dual USB Firmware - Default SDK Configuration

# Partition Table Configuration
CONFIG_PARTITION_TABLE_CUSTOM=y
CONFIG_PARTITION_TABLE_CUSTOM_FILENAME="partitions.csv"
CONFIG_PARTITION_TABLE_FILENAME="partitions.csv"

# Flash Size Configuration
CONFIG_ESPTOOLPY_FLASHSIZE_16MB=y

# FreeRTOS
CONFIG_FREERTOS_HZ=1000

# FATFS
CONFIG_FATFS_LFN_STACK=1
CONFIG_FATFS_CODEPAGE_437=y
CONFIG_FATFS_FS_LOCK=4
CONFIG_FATFS_IMMEDIATE_FSYNC=y

# Wear Levelling Configuration
CONFIG_WL_SECTOR_SIZE=4096

# TinyUSB
CONFIG_TINYUSB_MSC_ENABLED=y
CONFIG_TINYUSB_DEBUG_LEVEL=0

# USB Device
CONFIG_USB_DEVICE_STACK=y

# Logging
CONFIG_LOG_DEFAULT_LEVEL=3
```
